## CMakeLists.txt
```
cmake_minimum_required(VERSION 3.20.0)
find_package(Zephyr REQUIRED HINTS $ENV{ZEPHYR_BASE})
project(portatil)

target_sources(app PRIVATE src/main.c
 src/light_indicator.c
 src/wifi_init.c
 
 )
```

## prj.conf
```kconfig
CONFIG_PRINTK=y
CONFIG_ASSERT=y
CONFIG_GPIO=y
CONFIG_MAKEFILE_EXPORTS=y

CONFIG_WIFI=y
CONFIG_WIFI_ESP32=y
CONFIG_HEAP_MEM_POOL_SIZE=98304

CONFIG_NETWORKING=y
CONFIG_NET_L2_ETHERNET=y

CONFIG_NET_IPV6=n
CONFIG_NET_IPV4=y
CONFIG_NET_DHCPV4=y

CONFIG_NET_MGMT=y
CONFIG_NET_MGMT_EVENT=y

CONFIG_NET_LOG=y
CONFIG_NET_SHELL=n

CONFIG_MBEDTLS=y
CONFIG_MBEDTLS_ENTROPY_ENABLED=y
CONFIG_MBEDTLS_KEY_EXCHANGE_ECDHE_ECDSA_ENABLED=y
CONFIG_MBEDTLS_ECP_ALL_ENABLED=y

CONFIG_ESP32_WIFI_SSID="kleyson"
CONFIG_ESP32_WIFI_PASSWORD="3249101318"
```

## src/main.c
```c
#include <zephyr.h>
#include <zephyr/kernel.h>
#include <drivers/gpio.h>

#include "light_indicator.h"
#include "wifi_init.h"

#define MY_STACK_SIZE 512
#define MY_PRIORITY 5



static const struct led_name_alias led0 = {
	.spec = GPIO_DT_SPEC_GET_OR(LED0, gpios, {0}),
};

static const struct led_name_alias led1 = {
	.spec = GPIO_DT_SPEC_GET_OR(LED1, gpios, {0}),
};

static const struct led_name_alias led2 = {
	.spec = GPIO_DT_SPEC_GET_OR(LED2, gpios, {0}),
};

K_FIFO_DEFINE(printk_fifo);

void main(void) {

		struct net_if *iface;

	net_mgmt_init_event_callback(&dhcp_cb, handler_cb,
				     NET_EVENT_IPV4_DHCP_BOUND);

	net_mgmt_add_event_callback(&dhcp_cb);

	iface = net_if_get_default();
	if (!iface) {
		printk("wifi interface not available");
		return;
	}

	net_dhcpv4_start(iface);

	if (!IS_ENABLED(CONFIG_ESP32_WIFI_STA_AUTO)) {
		wifi_config_t wifi_config = {
			.sta = {
				.ssid = CONFIG_ESP32_WIFI_SSID,
				.password = CONFIG_ESP32_WIFI_PASSWORD,
			},
		};

		esp_err_t ret = esp_wifi_set_mode(WIFI_MODE_STA);

		ret |= esp_wifi_set_config(ESP_IF_WIFI_STA, &wifi_config);
		ret |= esp_wifi_connect();
		if (ret != ESP_OK) {
			printk("connection failed");
		}

	}

	
} // end main

void blink1(void) {
	led_thread(&led0, 500);
}

void blink2(void) {
	led_thread(&led1, 250);
}  
 void blink3(void) {
	led_thread(&led2, 30);
} 


K_THREAD_DEFINE(name_process_led1, MY_STACK_SIZE,
                blink1, NULL, NULL, NULL,
                MY_PRIORITY, 0, 0);


 K_THREAD_DEFINE(name_process_led2, MY_STACK_SIZE,
blink2, NULL, NULL, NULL,
MY_PRIORITY, 0, 0);

K_THREAD_DEFINE(name_process_led3, MY_STACK_SIZE,
blink3, NULL, NULL, NULL,
MY_PRIORITY, 0, 0); 
```

## src/light_indicator.c
```c
#include "light_indicator.h"

static const struct gpio_dt_spec  led1 = GPIO_DT_SPEC_GET(LED1, gpios);

	 void led_thread(const struct led_name_alias *led, int32_t ms) {
	const struct gpio_dt_spec *spec = &led->spec;
	int ret;
	if(!z_device_is_ready(spec->port)) {
		printk("Erro port led.port");
		return;
	}
	ret = gpio_pin_configure_dt(spec, GPIO_OUTPUT_ACTIVE);
	
	if(ret < 0) {
		printk("ret < 0");
		return;
	}

	while(1) {
		ret = gpio_pin_toggle_dt(spec);

		if(ret < 0) {
			printk("ret < 0, while");
			return;
		}
		k_msleep(ms);

	}
	} 
```

## src/light_indicator.h
```c
#ifndef LIGHT_INDICATE_H
#define LIGHT_INDICATE_H

#include <drivers/gpio.h>

#define LED0 DT_ALIAS(led0)
#define LED1 DT_ALIAS(led1)
#define LED2 DT_ALIAS(led2)

#define DELAY_MS_LED0 1000
#define DELAY_MS_LED1 100
#define DELAY_MS_LED2 20

	struct led_name_alias {
		struct gpio_dt_spec spec;
		const char *pgio_pin_name;
	};

	void led_thread(const struct led_name_alias *led, int32_t ms);



#endif
```

## src/wifi_init.c
```c
#include "wifi_init.h"



static struct net_mgmt_event_callback dhcp_cb;

 void handler_cb(struct net_mgmt_event_callback *cb,
		    uint32_t mgmt_event, struct net_if *iface)
{


	if (mgmt_event != NET_EVENT_IPV4_DHCP_BOUND) {
		return;
	}

	char buf[NET_IPV4_ADDR_LEN];

	printk("Your address: %s",
		log_strdup(net_addr_ntop(AF_INET,
				   &iface->config.dhcpv4.requested_ip,
				   buf, sizeof(buf))));
	printk("Lease time: %u seconds",
			iface->config.dhcpv4.lease_time);
	printk("Subnet: %s",
		log_strdup(net_addr_ntop(AF_INET,
					&iface->config.ip.ipv4->netmask,
					buf, sizeof(buf))));
	printk("Router: %s",
		log_strdup(net_addr_ntop(AF_INET,
						&iface->config.ip.ipv4->gw,
						buf, sizeof(buf))));
}
```

## src/wifi_init.h
```c
/* 
Configuração sos esp32 como stacao de conecxão
 */
#ifndef WIFI_INIT_H
#define WIFI_INIT_H

#include <sys/printk.h>
#include <esp_wifi.h>
#include <esp_timer.h>
#include <esp_event.h>


#include <net/net_if.h>
#include <net/net_core.h>
#include <net/net_context.h>
#include <net/net_mgmt.h>



 void handler_cb(struct net_mgmt_event_callback *cb,
		    uint32_t mgmt_event, struct net_if *iface);

#endif
```
